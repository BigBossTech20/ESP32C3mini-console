/*
 * ESP32-C3-Zero + SSD1306 128x64
 * Menu: DINO / DOOM
 * Buttons: OK=GP1, UP=GP2, LEFT=GP3, RIGHT=GP5
 */
#include <Wire.h>
#include <Adafruit_GFX.h>
#include <Adafruit_SSD1306.h>
#include <Preferences.h>
#include <math.h>

#define SCREEN_WIDTH  128
#define SCREEN_HEIGHT 64
#define OLED_RESET    -1
#define OLED_ADDR     0x3C

#define PIN_OK     1
#define PIN_UP     2
#define PIN_LEFT   3
#define PIN_RIGHT  5
#define PIN_SDA    6
#define PIN_SCL    7

#define COLLISION_DIST   5
#define WALL_OFFSET      0
#define NUM_WALLS        4
#define UI_HEIGHT        54
#define DOOM_INTRO_MS    2000
#define LOGO_WIDTH 128
#define LOGO_HEIGHT 64
#define GUN_WIDTH   32
#define GUN_HEIGHT  32
#define FLASH_WIDTH 16
#define FLASH_HEIGHT 15


enum texture { CHECK, STRIPE_V, STRIPE_H, STRIPE_D };

struct vec2 { float x, y; };

struct wall {
  vec2 points[2];
  texture tex;
};


float pow2(float x);
float dist2(vec2 v, vec2 u);
bool collision_detection(const wall walls[], vec2 p);
void raycast(const wall* walls, vec2 p, int pa, bool show_gun);
void vertical_line(int x, int half_length);
void check_line(int x, int half_length, boolean phase);

Adafruit_SSD1306 display(SCREEN_WIDTH, SCREEN_HEIGHT, &Wire, OLED_RESET);
Preferences prefs;

enum AppState { STATE_MENU, STATE_DINO, STATE_DOOM };
AppState appState = STATE_MENU;

enum MenuItem { MENU_DINO = 0, MENU_DOOM = 1 };
MenuItem menuSelection = MENU_DINO;

const unsigned long DEBOUNCE_MS   = 40;
const unsigned long LONG_PRESS_MS = 1500;

struct Btn {
  uint8_t pin;
  bool lastState;
  unsigned long lastDebounce;
  unsigned long pressStart;
};

Btn btnOk    = {PIN_OK,    LOW, 0, 0};
Btn btnUp    = {PIN_UP,    LOW, 0, 0};
Btn btnLeft  = {PIN_LEFT,  LOW, 0, 0};
Btn btnRight = {PIN_RIGHT, LOW, 0, 0};

bool readClick(Btn &b) {
  bool clicked = false;
  bool reading = digitalRead(b.pin);
  if (reading == HIGH && b.lastState == LOW) {
    if (millis() - b.lastDebounce > DEBOUNCE_MS) {
      clicked = true;
      b.lastDebounce = millis();
      b.pressStart = millis();
    }
  }
  if (reading == LOW) b.pressStart = 0;
  b.lastState = reading;
  return clicked;
}

bool isHeld(Btn &b) {
  return digitalRead(b.pin) == HIGH;
}

bool isLongPress(Btn &b) {
  if (isHeld(b) && b.pressStart > 0) {
    return (millis() - b.pressStart) >= LONG_PRESS_MS;
  }
  return false;
}

// ===================== DINO =====================
const int GROUND_Y      = 52;
const int DINO_X        = 18;
const int DINO_W        = 10;
const int DINO_H        = 14;
const int DINO_GROUND_Y = GROUND_Y - DINO_H;
const int JUMP_VELOCITY = -8;
const int GRAVITY       = 1;

const int OBS_W_MIN = 6,  OBS_W_MAX = 10;
const int OBS_H_MIN = 10, OBS_H_MAX = 20;
const int OBS_GAP_MIN = 20, OBS_GAP_MAX = 65;

const float SPEED_START = 3.2f;
const float SPEED_MAX   = 9.5f;
const float SPEED_STEP  = 0.05f;

const unsigned long SCORE_INTERVAL_MS = 100;
const long SCORE_PER_TICK = 5;
const unsigned long FRAME_DELAY_MS = 15;

int dinoY = DINO_GROUND_Y;
int dinoVy = 0;
bool isJumping = false;
int obstacleX = SCREEN_WIDTH;
int obstacleW = OBS_W_MIN;
int obstacleH = OBS_H_MIN;
long score = 0;
long highScore = 0;
float gameSpeed = SPEED_START;
bool dinoStarted = false;
bool dinoGameOver = false;
unsigned long lastScoreTime = 0;

void spawnObstacle() {
  obstacleX = SCREEN_WIDTH + random(OBS_GAP_MIN, OBS_GAP_MAX);
  obstacleW = random(OBS_W_MIN, OBS_W_MAX + 1);
  obstacleH = random(OBS_H_MIN, OBS_H_MAX + 1);
}

void resetDino() {
  score = 0;
  dinoY = DINO_GROUND_Y;
  dinoVy = 0;
  isJumping = false;
  gameSpeed = SPEED_START;
  obstacleX = SCREEN_WIDTH;
  spawnObstacle();
  dinoGameOver = false;
  lastScoreTime = millis();
}

void updateDino(bool jumpPressed) {
  if (jumpPressed && !isJumping) {
    dinoVy = JUMP_VELOCITY;
    isJumping = true;
  }
  dinoY += dinoVy;
  dinoVy += GRAVITY;
  if (dinoY > DINO_GROUND_Y) {
    dinoY = DINO_GROUND_Y;
    dinoVy = 0;
    isJumping = false;
  }
}

void updateObstacle() {
  obstacleX -= (int)gameSpeed;
  if (obstacleX < -obstacleW) {
    spawnObstacle();
    if (gameSpeed < SPEED_MAX) gameSpeed += SPEED_STEP;
  }
}

void updateScore() {
  if (millis() - lastScoreTime > SCORE_INTERVAL_MS) {
    score += SCORE_PER_TICK;
    lastScoreTime = millis();
  }
}

bool checkCollision() {
  bool xOverlap = (obstacleX < DINO_X + DINO_W) && (obstacleX + obstacleW > DINO_X);
  int obstacleTopY = GROUND_Y - obstacleH;
  bool yOverlap = (dinoY + DINO_H) > obstacleTopY;
  return xOverlap && yOverlap;
}

void endDino() {
  dinoGameOver = true;
  if (score > highScore) {
    highScore = score;
    prefs.putLong("highscore", highScore);
  }
}

void drawDinoStart() {
  display.setTextSize(1);
  display.setTextColor(SSD1306_WHITE);
  display.setCursor(28, 18);
  display.print(F("DINO GAME"));
  display.setCursor(10, 34);
  display.print(F("Hi-Score: "));
  display.print(highScore);
  display.setCursor(8, 50);
  display.print(F("> Press OK to Play <"));
}

void drawDinoHud() {
  display.setTextSize(1);
  display.setTextColor(SSD1306_WHITE);
  display.setCursor(55, 2);
  display.print(F("SCORE:"));
  display.print(score);
  display.setCursor(55, 12);
  display.print(F("HI:"));
  display.print(highScore);
}

void drawGround() {
  display.drawLine(0, GROUND_Y, SCREEN_WIDTH - 1, GROUND_Y, SSD1306_WHITE);
}

void drawDinoSprite() {
  display.fillRect(DINO_X, dinoY, DINO_W, DINO_H, SSD1306_WHITE);
}

void drawObstacle() {
  display.fillRect(obstacleX, GROUND_Y - obstacleH, obstacleW, obstacleH, SSD1306_WHITE);
}

void drawDinoGameOver() {
  display.drawRect(5, 5, 118, 54, SSD1306_WHITE);
  display.drawRect(7, 7, 114, 50, SSD1306_WHITE);
  display.setTextSize(1);
  display.setTextColor(SSD1306_WHITE);
  display.setCursor(36, 15);
  display.print(F("GAME OVER"));
  display.setCursor(20, 30);
  display.print(F("Score: "));
  display.print(score);
  display.setCursor(16, 45);
  display.print(F("Press OK to retry"));
}

// ===================== DOOM (raycaster) =====================
const unsigned char PROGMEM doom_logo [] = {
0x7F, 0xFF, 0xFF, 0xFE, 0x03, 0xFF, 0xFF, 0xF8, 0x1F, 0xFF, 0xFF, 0xC3, 0xFF, 0x80, 0xFF, 0xFE,
0x3F, 0xFF, 0xFF, 0xFF, 0x87, 0xFF, 0xFF, 0xFC, 0x3F, 0xFF, 0xFF, 0xF3, 0xFF, 0x81, 0xFF, 0xFC,
0x1F, 0xFF, 0xFF, 0xFF, 0xDF, 0xFF, 0xFF, 0xFE, 0x7F, 0xFF, 0xFF, 0xFB, 0xFF, 0xC1, 0xFF, 0xF8,
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0x04, 0x00, 0x00, 0x00, 0x00, 0x00, 0x00, 0x00, 0x00, 0x00, 0x00, 0x00, 0x00, 0x00, 0x00, 0x00
};

const unsigned char PROGMEM gun_bmp[] = {
0x00, 0x00, 0x20, 0x00, 0x00, 0x00, 0xd8, 0x00, 0x00, 0x01, 0xc4, 0x00, 0x00, 0x02, 0x04, 0x00,
0x00, 0x02, 0x02, 0x00, 0x00, 0x02, 0xea, 0x00, 0x00, 0x04, 0xd1, 0x00, 0x00, 0x09, 0x88, 0x80,
0x00, 0x19, 0x00, 0x00, 0x00, 0x0d, 0xc2, 0x80, 0x00, 0x29, 0x81, 0xc0, 0x00, 0x0b, 0xa2, 0x20,
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0x17, 0xd7, 0xe5, 0x00, 0x1b, 0x8f, 0xb2, 0x30, 0x03, 0x7d, 0x58, 0x10, 0x6f, 0xbf, 0xec, 0x20
};

const unsigned char PROGMEM gun_bmp_mask[] = {
0x00, 0x00, 0x70, 0x00, 0x00, 0x01, 0xfc, 0x00, 0x00, 0x03, 0xfe, 0x00, 0x00, 0x07, 0xfe, 0x00,
0x00, 0x07, 0xff, 0x00, 0x00, 0x07, 0xff, 0x00, 0x00, 0x0f, 0xff, 0x80, 0x00, 0x1f, 0xff, 0xc0,
0x00, 0x3f, 0xff, 0x80, 0x00, 0x3f, 0xff, 0xc0, 0x00, 0x7f, 0xff, 0xe0, 0x00, 0x7f, 0xff, 0xf0,
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0x7f, 0xff, 0xff, 0xf8, 0x7f, 0xff, 0xff, 0xf8, 0x7f, 0xff, 0xff, 0xf8, 0xff, 0xff, 0xff, 0xf0
};

const unsigned char PROGMEM muzzle_flash_bmp [] = {
0x01, 0x00, 0x03, 0xC0, 0x05, 0xC0, 0x07, 0xE0, 0x0F, 0xE0, 0x3F, 0xE0, 0x3F, 0xD0, 0x3F, 0xFC,
0x3F, 0xFC, 0x7F, 0xFF, 0xFF, 0xFF, 0xFF, 0xFF, 0xFF, 0xFF, 0x7F, 0xFC, 0x2F, 0xFC, 
};

const int rotSpeed = 5;

const wall walls[NUM_WALLS] = {
  { { {10, 10}, {10, 120} }, CHECK },
  { { {10, 120}, {120, 120} }, CHECK },
  { { {120, 120}, {120, 10} }, CHECK },
  { { {120, 10}, {10, 10} }, CHECK }
};

vec2 doomP = { 20.0f, 20.0f };
int doomPa = 0;
int shot_timer = 0;
long doomScore = 0;
long doomHighScore = 0;
bool doomStarted = false;
unsigned long doomStartTime = 0;
unsigned long lastDoomScoreTick = 0;

float pow2(float x) { return x * x; }
float dist2(vec2 v, vec2 u) { return pow2(v.x - u.x) + pow2(v.y - u.y); }

void vertical_line(int x, int half_length) {
  for (int i = 0; i < half_length; i += 2) {
    display.drawPixel(x, UI_HEIGHT/2 + WALL_OFFSET + i, SSD1306_WHITE);
    if (UI_HEIGHT/2 + WALL_OFFSET - i < UI_HEIGHT) {
      display.drawPixel(x, UI_HEIGHT/2 + WALL_OFFSET - i, SSD1306_WHITE);
    }
  }
}

void check_line(int x, int half_length, boolean phase) {
  int lower = UI_HEIGHT/2 - half_length + WALL_OFFSET;
  int upper = UI_HEIGHT/2 + half_length + WALL_OFFSET;

  for (int i = lower; i < upper; i += 2) {
    if (i > UI_HEIGHT) break;

    if (phase) {
      if (i == lower || (i >= lower + half_length && i <= lower + 3*half_length/2)) {
        i += half_length/2;
      }
    } else {
      if ((i >= lower + half_length/2 && i <= lower + half_length) || (i >= lower + 3*half_length/2 && i <= upper)) {
        i += half_length/2;
      }
    }

    display.drawPixel(x, i, SSD1306_WHITE);
  }
  display.drawPixel(x, UI_HEIGHT/2 - half_length + WALL_OFFSET, SSD1306_WHITE);
  display.drawPixel(x, UI_HEIGHT/2 + half_length + WALL_OFFSET, SSD1306_WHITE);
}

bool collision_detection(const wall walls[], vec2 p) {
  int collision_dist2 = COLLISION_DIST * COLLISION_DIST;
  for (int i = 0; i < NUM_WALLS; i++) {
    wall w = walls[i];
    float w2 = dist2(w.points[0], w.points[1]);
    if (w2 == 0) continue;

    float t = ((p.x - w.points[0].x) * (w.points[1].x - w.points[0].x) + (p.y - w.points[0].y) * (w.points[1].y - w.points[0].y)) / w2;
    float d2 = dist2(p, {w.points[0].x + t * (w.points[1].x - w.points[0].x), w.points[0].y + t * (w.points[1].y - w.points[0].y)});

    if (d2 < collision_dist2) return true;
  }
  return false;
}

void raycast(const wall* walls, vec2 p, int pa, bool show_gun) {
  float dov = 10.0f;
  float fov = 80.0f;

  float x3 = p.x;
  float y3 = p.y;
  float x4, y4;

  for (int i = 0; i < 128; i += 2) {
    float angle = (i*(fov/127.0f)) - (fov/2.0f);

    x4 = p.x + dov*cosf((pa + angle) * (PI/180));
    y4 = p.y + dov*sinf((pa + angle) * (PI/180));

    float dist = 100000.0f;
    vec2 pt_final = { NAN, NAN };
    wall cur_wall;
    int cur_edge2pt = 0;

    for (int w = 0; w < NUM_WALLS; w++) {
      float x1 = walls[w].points[0].x;
      float y1 = walls[w].points[0].y;
      float x2 = walls[w].points[1].x;
      float y2 = walls[w].points[1].y;

      float denominator = (x1-x2)*(y3-y4)-(y1-y2)*(x3-x4);
      if (denominator == 0) continue;

      float t = ((x1-x3)*(y3-y4)-(y1-y3)*(x3-x4))/denominator;
      float u = -((x1-x2)*(y1-y3)-(y1-y2)*(x1-x3))/denominator;

      if (t > 0 && t < 1 && u > 0) {
        vec2 pt = { x1 + t * (x2 - x1), y1 + t * (y2 - y1) };
        float ptDist2 = dist2(pt, p);

        if (ptDist2 < dist) {
          dist = ptDist2;
          pt_final = pt;
          cur_wall = walls[w];
          cur_edge2pt = dist2(pt, cur_wall.points[0]);
        }
      }
    }

    if (!isnan(pt_final.x)) {
      int length = 25000 / dist;

      int wall_len = dist2(cur_wall.points[0], cur_wall.points[1]);
      if (cur_edge2pt < 2 || wall_len - cur_edge2pt < 2) {
        vertical_line(i, length);
        continue;
      }

      if (cur_wall.tex == CHECK) {
        check_line(i, length, (cur_edge2pt % 1000) < 500);
      }
    }
  }

  if (show_gun) {
    display.drawBitmap(SCREEN_WIDTH/2 - FLASH_WIDTH/2 + 2, UI_HEIGHT - 3*FLASH_HEIGHT/4 - GUN_HEIGHT, muzzle_flash_bmp, FLASH_WIDTH, FLASH_HEIGHT, SSD1306_WHITE);
  }

  display.drawBitmap(SCREEN_WIDTH/2 - GUN_WIDTH/2, UI_HEIGHT - GUN_HEIGHT, gun_bmp_mask, GUN_WIDTH, GUN_HEIGHT, SSD1306_BLACK);
  display.drawBitmap(SCREEN_WIDTH/2 - GUN_WIDTH/2, UI_HEIGHT - GUN_HEIGHT, gun_bmp, GUN_WIDTH, GUN_HEIGHT, SSD1306_WHITE);
}

void resetDoom() {
  doomP = { 20.0f, 20.0f };
  doomPa = 0;
  shot_timer = 0;
  doomScore = 0;
  doomStartTime = millis();
  lastDoomScoreTick = millis();

  display.clearDisplay();
  display.drawBitmap(0, 0, doom_logo, LOGO_WIDTH, LOGO_HEIGHT, SSD1306_WHITE);
  display.display();
  delay(DOOM_INTRO_MS);
  display.clearDisplay();
}

void updateDoom() {
  if (isHeld(btnOk) && shot_timer == 0) {
    shot_timer = 5;
  }
  if (shot_timer > 0) shot_timer--;

  if (isHeld(btnLeft)) {
    doomPa = (doomPa - rotSpeed < 0 ? doomPa - rotSpeed + 360 : doomPa - rotSpeed);
  }
  if (isHeld(btnRight)) {
    doomPa = (doomPa + rotSpeed >= 360 ? doomPa + rotSpeed - 360 : doomPa + rotSpeed);
  }
  if (isHeld(btnUp)) {
    vec2 pn = { doomP.x + 2*cos(doomPa * (PI/180)), doomP.y + 2*sin(doomPa * (PI/180)) };
    if (!collision_detection(walls, pn)) {
      doomP = pn;
    }
  }

  if (millis() - lastDoomScoreTick > 100) {
    doomScore += 5;
    lastDoomScoreTick = millis();
    if (doomScore > doomHighScore) {
      doomHighScore = doomScore;
      prefs.putLong("doomhigh", doomHighScore);
    }
  }
}

void renderDoom() {
  display.clearDisplay();
  for (int i = 0; i < SCREEN_WIDTH; i++) {
    display.drawPixel(i, UI_HEIGHT, SSD1306_WHITE);
  }

  char buf[16];
  display.setTextSize(1);
  display.setTextColor(SSD1306_WHITE);

  display.setCursor(2, UI_HEIGHT + 3);
  sprintf(buf, "SCORE:%li", doomScore);
  display.println(buf);

  display.setCursor(SCREEN_WIDTH/2 + 2, UI_HEIGHT + 3);
  sprintf(buf, "TIME:%lu", (millis() - doomStartTime)/1000);
  display.println(buf);

  raycast(walls, doomP, doomPa, shot_timer > 0);
  display.display();
}

void drawDoomStart() {
  display.clearDisplay();
  display.setTextSize(1);
  display.setTextColor(SSD1306_WHITE);
  display.setCursor(48, 10);
  display.print(F("DOOM"));
  display.setCursor(14, 30);
  display.print(F("Hi-Score: "));
  display.print(doomHighScore);
  display.setCursor(8, 50);
  display.print(F("> Press OK to Play <"));
  display.display();
}

// ===================== MENU =====================
void drawMenu() {
  display.clearDisplay();
  display.setTextSize(1);
  display.setTextColor(SSD1306_WHITE);

  display.drawRect(22, 1, 84, 13, SSD1306_WHITE);

  display.setCursor(34, 4);
  display.print(F("SELECT GAME"));

  if (menuSelection == MENU_DINO) {
    display.fillRect(10, 22, 108, 14, SSD1306_WHITE);
    display.setTextColor(SSD1306_BLACK);
  } else {
    display.setTextColor(SSD1306_WHITE);
  }
  display.setCursor(40, 25);
  display.print(F("DINO GAME"));

  if (menuSelection == MENU_DOOM) {
    display.fillRect(10, 40, 108, 14, SSD1306_WHITE);
    display.setTextColor(SSD1306_BLACK);
  } else {
    display.setTextColor(SSD1306_WHITE);
  }
  display.setCursor(48, 43);
  display.print(F("DOOM"));

  display.setTextColor(SSD1306_WHITE);
  display.setCursor(0, 56);
  display.print(F("L/R=select   OK=start"));
}

// ===================== SETUP / LOOP =====================
void setup() {
  Serial.begin(115200);

  pinMode(PIN_OK,    INPUT_PULLDOWN);
  pinMode(PIN_UP,    INPUT_PULLDOWN);
  pinMode(PIN_LEFT,  INPUT_PULLDOWN);
  pinMode(PIN_RIGHT, INPUT_PULLDOWN);

  Wire.begin(PIN_SDA, PIN_SCL);
  if (!display.begin(SSD1306_SWITCHCAPVCC, OLED_ADDR)) {
    Serial.println(F("OLED failed"));
    for (;;);
  }

  prefs.begin("dinogame", false);
  highScore = prefs.getLong("highscore", 0);
  doomHighScore = prefs.getLong("doomhigh", 0);

  randomSeed(analogRead(0));

  display.clearDisplay();
  display.display();
}

void loop() {
  bool clickOk    = readClick(btnOk);
  bool clickUp    = readClick(btnUp);
  bool clickLeft  = readClick(btnLeft);
  bool clickRight = readClick(btnRight);

  if (appState == STATE_MENU) {
    if (clickLeft || clickRight) {
      menuSelection = (menuSelection == MENU_DINO) ? MENU_DOOM : MENU_DINO;
    }
    if (clickOk) {
      if (menuSelection == MENU_DINO) {
        appState = STATE_DINO;
        dinoStarted = false;
        resetDino();
      } else {
        appState = STATE_DOOM;
        doomStarted = false;
      }
    }
    drawMenu();
    display.display();
    delay(30);
    return;
  }

  if (isLongPress(btnOk)) {
    appState = STATE_MENU;
    btnOk.pressStart = 0;
    return;
  }

  if (appState == STATE_DINO) {
    if (!dinoStarted) {
      if (clickOk) {
        dinoStarted = true;
        resetDino();
      }
      display.clearDisplay();
      drawDinoStart();
      display.display();
      delay(FRAME_DELAY_MS);
      return;
    }

    if (dinoGameOver) {
      if (clickOk) resetDino();
      display.clearDisplay();
      drawDinoGameOver();
      display.display();
      delay(FRAME_DELAY_MS);
      return;
    }

    bool jump = clickOk || clickUp;
    updateDino(jump);
    updateObstacle();
    updateScore();
    if (checkCollision()) endDino();

    display.clearDisplay();
    drawDinoHud();
    drawGround();
    drawDinoSprite();
    drawObstacle();
    display.display();
    delay(FRAME_DELAY_MS);
    return;
  }

  if (appState == STATE_DOOM) {
    if (!doomStarted) {
      if (clickOk) {
        doomStarted = true;
        resetDoom();
      } else {
        drawDoomStart();
      }
      delay(30);
      return;
    }

    updateDoom();
    renderDoom();
    delay(20);
  }
}